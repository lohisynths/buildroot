## configs/raspberrypi2_defconfig
```kconfig
BR2_arm=y
BR2_cortex_a7=y

BR2_ARM_FPU_NEON_VFPV4=y

### BR2_TOOLCHAIN_BUILDROOT_CXX=y

BR2_SYSTEM_DHCP="eth0"

# Linux headers same as kernel, a 4.14 series
BR2_PACKAGE_HOST_LINUX_HEADERS_CUSTOM_4_14=y

BR2_LINUX_KERNEL=y
BR2_LINUX_KERNEL_CUSTOM_TARBALL=y
BR2_LINUX_KERNEL_CUSTOM_TARBALL_LOCATION="$(call github,raspberrypi,linux,c117a8bccf37bfba323065b566cf999ed4629a4a)/linux-c117a8bccf37bfba323065b566cf999ed4629a4a.tar.gz"
BR2_LINUX_KERNEL_DEFCONFIG="bcm2709"

# Build the DTB from the kernel sources
BR2_LINUX_KERNEL_DTS_SUPPORT=y
BR2_LINUX_KERNEL_INTREE_DTS_NAME="bcm2709-rpi-2-b"

BR2_PACKAGE_RPI_FIRMWARE=y


# Required tools to create the SD image
BR2_PACKAGE_HOST_DOSFSTOOLS=y
BR2_PACKAGE_HOST_GENIMAGE=y
BR2_PACKAGE_HOST_MTOOLS=y

# Filesystem / image
BR2_TARGET_ROOTFS_EXT2=y
BR2_TARGET_ROOTFS_EXT2_4=y
# BR2_TARGET_ROOTFS_TAR is not set
BR2_ROOTFS_POST_BUILD_SCRIPT="board/raspberrypi2/post-build.sh"
BR2_ROOTFS_POST_IMAGE_SCRIPT="board/raspberrypi2/post-image.sh"
##############################################################

BR2_LINUX_KERNEL_USE_CUSTOM_CONFIG=y
BR2_LINUX_KERNEL_CUSTOM_CONFIG_FILE="board/raspberrypi/lohi_kernel_defconfig"


BR2_CCACHE=y
BR2_OPTIMIZE_3=y
BR2_TOOLCHAIN_EXTERNAL=y


BR2_TARGET_ROOTFS_EXT2_SIZE="200M"

BR2_ROOTFS_DEVICE_CREATION_DYNAMIC_EUDEV=y

##############################################################
BR2_PACKAGE_DT_UTILS=y


#BR2_ENABLE_DEBUG=y
#BR2_PACKAGE_GTEST=y

BR2_SHARED_STATIC_LIBS=y

BR2_PACKAGE_ALSA_UTILS=y
BR2_PACKAGE_ALSA_UTILS_ALSACONF=y
BR2_PACKAGE_ALSA_UTILS_ACONNECT=y
BR2_PACKAGE_ALSA_UTILS_ALSALOOP=y
BR2_PACKAGE_ALSA_UTILS_ALSAUCM=y
BR2_PACKAGE_ALSA_UTILS_ALSATPLG=y
BR2_PACKAGE_ALSA_UTILS_AMIDI=y
BR2_PACKAGE_ALSA_UTILS_AMIXER=y
BR2_PACKAGE_ALSA_UTILS_APLAY=y
BR2_PACKAGE_ALSA_UTILS_APLAYMIDI=y
BR2_PACKAGE_ALSA_UTILS_ARECORDMIDI=y
BR2_PACKAGE_ALSA_UTILS_ASEQDUMP=y
BR2_PACKAGE_ALSA_UTILS_ASEQNET=y
BR2_PACKAGE_ALSA_UTILS_BAT=y
BR2_PACKAGE_ALSA_UTILS_IECSET=y
BR2_PACKAGE_ALSA_UTILS_SPEAKER_TEST=y

BR2_PACKAGE_RPI_FIRMWARE_INSTALL_VCDBG=y
BR2_PACKAGE_OPENSSH=y
BR2_PACKAGE_HTOP=y

BR2_PACKAGE_RT_TESTS=y
BR2_PACKAGE_ATEST=y
BR2_PACKAGE_STRESS=y
BR2_PACKAGE_STRESS_NG=y

BR2_PACKAGE_STRACE=y
BR2_PACKAGE_TRACE_CMD=y

BR2_PACKAGE_LTTNG_MODULES=y
BR2_PACKAGE_LTTNG_LIBUST=y
BR2_PACKAGE_LTTNG_TOOLS=y
BR2_PACKAGE_LTTNG_BABELTRACE=y

BR2_PACKAGE_UTIL_LINUX_SCHEDUTILS=y

BR2_ROOTFS_USERS_TABLES="board/raspberrypi/users_table.txt"



BR2_PACKAGE_NTP=y


BR2_PACKAGE_LINUX_TOOLS_PERF=y
# symbols from lttng userspace
BR2_PACKAGE_ELFUTILS=y
#BR2_PACKAGE_ELFUTILS_PROGS=y
# enable demangling
BR2_PACKAGE_BINUTILS=y

BR2_PACKAGE_GDB=y

BR2_PACKAGE_MINICOM=y
```
